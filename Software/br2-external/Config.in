## Software/br2-external/Config.in
```kconfig
# SPDX-License-Identifier: CC-BY-NC-ND-4.0
#
# Config.in - CHC5 Buildroot menu
#
# Copyright (c) 2026 Circuit Valley - Author: Gaurav Singh
# https://creativecommons.org/licenses/by-nc-nd/4.0/

menu "CHC5 Open Camera"

source "$BR2_EXTERNAL_CHC5_PATH/package/chc5_platformd/Config.in"
source "$BR2_EXTERNAL_CHC5_PATH/package/chc5_webd/Config.in"
source "$BR2_EXTERNAL_CHC5_PATH/package/camcfgd/Config.in"
source "$BR2_EXTERNAL_CHC5_PATH/package/gvcp_server/Config.in"

endmenu
```

## Software/br2-external/board/chc5/kernel.its
```
/* SPDX-License-Identifier: CC-BY-NC-ND-4.0 */
/*
 * kernel.its - kernel FIT image description (zImage + device tree)
 *
 * Copyright (c) 2026 Circuit Valley - Author: Gaurav Singh
 * https://creativecommons.org/licenses/by-nc-nd/4.0/
 */

/dts-v1/;
/ {
	description = "CHC5 kernel FIT (zImage + DTB)";
	#address-cells = <1>;

	images {
		kernel {
			description = "Linux zImage";
			data = /incbin/("./zImage");
			type = "kernel";
			arch = "arm";
			os = "linux";
			compression = "none";
			load = <0x00208000>;
			entry = <0x00208000>;
			hash-1 { algo = "sha256"; };
		};
		fdt {
			description = "zynq-chc5 devicetree";
			data = /incbin/("./zynq-chc5.dtb");
			type = "flat_dt";
			arch = "arm";
			compression = "none";
			hash-1 { algo = "sha256"; };
		};
	};

	configurations {
		default = "conf";
		conf {
			description = "CHC5 default";
			kernel = "kernel";
			fdt = "fdt";
		};
	};
};
```

## Software/br2-external/package/camcfgd/Config.in
```kconfig
# SPDX-License-Identifier: CC-BY-NC-ND-4.0
#
# Config.in - Buildroot menu: camcfgd
#
# Copyright (c) 2026 Circuit Valley - Author: Gaurav Singh
# https://creativecommons.org/licenses/by-nc-nd/4.0/

config BR2_PACKAGE_CAMCFGD
	bool "camcfgd"
	depends on BR2_INIT_SYSTEMD
	depends on BR2_USE_MMU
	help
	  CHC5 Open Camera runtime-configuration daemon (gain, exposure, format,.

comment "camcfgd needs systemd"
	depends on !BR2_INIT_SYSTEMD
```

## Software/br2-external/package/chc5_platformd/Config.in
```kconfig
# SPDX-License-Identifier: CC-BY-NC-ND-4.0
#
# Config.in - Buildroot menu: chc5_platformd
#
# Copyright (c) 2026 Circuit Valley - Author: Gaurav Singh
# https://creativecommons.org/licenses/by-nc-nd/4.0/

config BR2_PACKAGE_CHC5_PLATFORMD
	bool "chc5_platformd"
	depends on BR2_INIT_SYSTEMD
	depends on BR2_USE_MMU
	select BR2_PACKAGE_XZ
	select BR2_PACKAGE_IPUTILS
	select BR2_PACKAGE_IPUTILS_ARPING
	select BR2_PACKAGE_IPROUTE2
	help
	  CHC5 Open Camera platform daemon.

if BR2_PACKAGE_CHC5_PLATFORMD

comment "--- Factory baseline (per camera model) ---"

config BR2_PACKAGE_CHC5_PLATFORMD_FACTORY_BITSTREAM
	string "Factory bitstream archive (basename in firmware_store/)"
	default ""
	help
	  Factory bitstream archive for this camera model.

config BR2_PACKAGE_CHC5_PLATFORMD_FACTORY_SENSOR
	string "Factory sensor archive (basename in firmware_store/)"
	default ""
	help
	  Factory sensor archive for this camera model.

config BR2_PACKAGE_CHC5_PLATFORMD_FACTORY_USB_FW
	string "Factory USB-FW archive (basename in firmware_store/)"
	default ""
	help
	  Factory USB firmware archive for this camera model.

config BR2_PACKAGE_CHC5_PLATFORMD_FACTORY_NETNAME
	string "Factory GigE Vision user-defined name"
	default "chc5-cam"
	help
	  Factory network name for this camera model.

endif

comment "chc5_platformd needs systemd"
	depends on !BR2_INIT_SYSTEMD
```

## Software/br2-external/package/chc5_webd/Config.in
```kconfig
# SPDX-License-Identifier: CC-BY-NC-ND-4.0
#
# Config.in - Buildroot menu: chc5_webd
#
# Copyright (c) 2026 Circuit Valley - Author: Gaurav Singh
# https://creativecommons.org/licenses/by-nc-nd/4.0/

config BR2_PACKAGE_CHC5_WEBD
	bool "chc5_webd"
	depends on BR2_INIT_SYSTEMD
	depends on BR2_USE_MMU
	depends on BR2_PACKAGE_CHC5_PLATFORMD
	depends on BR2_PACKAGE_CIVETWEB
	depends on BR2_PACKAGE_CIVETWEB_LIB
	select BR2_PACKAGE_LIBXCRYPT if BR2_TOOLCHAIN_USES_GLIBC
	help
	  CHC5 Open Camera web daemon (civetweb-based HTTP/WS UI on port 8080).

comment "chc5_webd needs systemd, chc5_platformd, and civetweb (lib)"
	depends on !BR2_INIT_SYSTEMD || !BR2_PACKAGE_CHC5_PLATFORMD || \
	           !BR2_PACKAGE_CIVETWEB || !BR2_PACKAGE_CIVETWEB_LIB
```

## Software/br2-external/package/gvcp_server/Config.in
```kconfig
# SPDX-License-Identifier: CC-BY-NC-ND-4.0
#
# Config.in - Buildroot menu: gvcp_server
#
# Copyright (c) 2026 Circuit Valley - Author: Gaurav Singh
# https://creativecommons.org/licenses/by-nc-nd/4.0/

config BR2_PACKAGE_GVCP_SERVER
	bool "gvcp_server"
	depends on BR2_INIT_SYSTEMD
	depends on BR2_USE_MMU
	help
	  CHC5 Open Camera GigE Vision Control Protocol server.

comment "gvcp_server needs systemd"
	depends on !BR2_INIT_SYSTEMD
```
