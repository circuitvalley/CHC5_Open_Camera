// SPDX-License-Identifier: CC-BY-NC-ND-4.0
/*
 * supplies.dtsi - IMX565 clock and power supplies
 *
 * Copyright (c) 2026 Circuit Valley - Author: Gaurav Singh
 * https://creativecommons.org/licenses/by-nc-nd/4.0/
 */

clk_37m125: clock_37m125 {
	compatible = "fixed-clock";
	#clock-cells = <0x00>;
	clock-frequency = <0x2367b88>;
};

imx565_vana: fixedregulator@3 {
	compatible = "regulator-fixed";
	regulator-name = "imx565_vana";
	regulator-min-microvolt = <0x325aa0>;
	regulator-max-microvolt = <0x325aa0>;
	enable-active-high;
};

imx565_vdig: fixedregulator@4 {
	compatible = "regulator-fixed";
	regulator-name = "imx565_vdig";
	regulator-min-microvolt = <0x10c8e0>;
	regulator-max-microvolt = <0x10c8e0>;
};

imx565_vddl: fixedregulator@5 {
	compatible = "regulator-fixed";
	regulator-name = "imx565_vddl";
	regulator-min-microvolt = <0x1b7740>;
	regulator-max-microvolt = <0x1b7740>;
};
